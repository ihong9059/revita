## ref/hwTest/flash_test/build/Kconfig/boards/Kconfig
```kconfig
# Load Zephyr board Kconfig descriptions.
osource "/home/uttec/ncs/zephyr/boards/nordic/nrf52840dk/Kconfig"
```

## ref/hwTest/serial_counter/build/serial_counter/Kconfig/boards/Kconfig.nrf52840dk
```kconfig
# Load board Kconfig descriptions.
osource "/home/uttec/ncs/zephyr/boards/nordic/nrf52840dk/Kconfig.nrf52840dk"
```

## zephyr_workspace/bleTest/central/build/Kconfig/boards/Kconfig.defconfig
```kconfig
# Load Zephyr board defconfig descriptions.
osource "/home/uttec/ncs/zephyr/boards/nordic/nrf52840dk/Kconfig.defconfig"
```

## zephyr_workspace/bleTest/peripheral/build/peripheral/Kconfig/boards/Kconfig.sysbuild
```kconfig
# Load Sysbuild board Kconfig descriptions.
osource "/home/uttec/ncs/zephyr/boards/nordic/nrf52840dk/Kconfig.sysbuild"
```

## zephyr_workspace/loraTest/central/build/Kconfig/boards/Kconfig.defconfig
```kconfig
# Load Zephyr board defconfig descriptions.
osource "/home/uttec/ncs/zephyr/boards/rakwireless/rak4631/Kconfig.defconfig"
```

## zephyr_workspace/loraTest/central/build/Kconfig/boards/Kconfig.rak4631
```kconfig
# Load board Kconfig descriptions.
osource "/home/uttec/ncs/zephyr/boards/rakwireless/rak4631/Kconfig.rak4631"
```

## zephyr_workspace/loraTest/central/build/central/Kconfig/boards/Kconfig.sysbuild
```kconfig
# Load Sysbuild board Kconfig descriptions.
osource "/home/uttec/ncs/zephyr/boards/rakwireless/rak4631/Kconfig.sysbuild"
```

## zephyr_workspace/loraTest/peripheral/build/Kconfig/arch/Kconfig
```kconfig
# Load Zephyr Arch Kconfig descriptions.
osource "/home/uttec/ncs/zephyr/arch/x86/Kconfig"
osource "/home/uttec/ncs/zephyr/arch/xtensa/Kconfig"
osource "/home/uttec/ncs/zephyr/arch/sparc/Kconfig"
osource "/home/uttec/ncs/zephyr/arch/riscv/Kconfig"
osource "/home/uttec/ncs/zephyr/arch/posix/Kconfig"
osource "/home/uttec/ncs/zephyr/arch/nios2/Kconfig"
osource "/home/uttec/ncs/zephyr/arch/mips/Kconfig"
osource "/home/uttec/ncs/zephyr/arch/arm64/Kconfig"
osource "/home/uttec/ncs/zephyr/arch/arm/Kconfig"
osource "/home/uttec/ncs/zephyr/arch/arc/Kconfig"
```

## zephyr_workspace/uart_test/target1/build/Kconfig/boards/Kconfig
```kconfig
# Load Zephyr board Kconfig descriptions.
osource "/home/uttec/ncs/zephyr/boards/rakwireless/rak4631/Kconfig"
```
